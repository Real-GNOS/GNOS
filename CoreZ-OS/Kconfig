## CoreZ-OS/Kconfig
```kconfig
mainmenu "CoreZ Kernel Configuration"

source "arch/Kconfig"

menu "Kernel features"

source "kernel/Kconfig"

endmenu
```

## CoreZ-OS/arch/Kconfig
```kconfig
choice
	prompt "Target architecture"
	default ARCH_X86_64

config ARCH_X86_64
	bool "x86_64"
	select ARCH_X86
	select 64BIT

config ARCH_AARCH64
	bool "aarch64"
	select 64BIT

endchoice

config ARCH_X86
	bool

config 64BIT
	bool
```

## CoreZ-OS/arch/x86/configs/x86_64_defconfig
```kconfig
CONFIG_ARCH_X86_64=y
CONFIG_ARCH_X86=y
CONFIG_64BIT=y
CONFIG_SMP=y
CONFIG_MUSL_LIB=y
CONFIG_FISH=y
CONFIG_UEFI=y
```

## CoreZ-OS/kernel/Kconfig
```kconfig
config SMP
	bool "Symmetric multi-processing"
	default y

config MUSL_LIB
	bool "Build native musl libc"
	default y

config FISH
	bool "Fish shell"
	default y

menu "Boot"

config UEFI
	bool "Self-made UEFI bootloader"
	default y
	help
	  构建自制 UEFI 引导器与 ESP 镜像

endmenu
```
